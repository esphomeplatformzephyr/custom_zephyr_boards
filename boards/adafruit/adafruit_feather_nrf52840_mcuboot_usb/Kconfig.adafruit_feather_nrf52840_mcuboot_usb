## boards/adafruit/adafruit_feather_nrf52840_mcuboot_usb/board.yml
```yaml
board:
  name: adafruit_feather_nrf52840_mcuboot_usb
  full_name: Feather nRF52840 Express (MCUboot + USB CDC-ACM serial recovery)
  vendor: adafruit
  socs:
    - name: nrf52840
```

## boards/arduino/nano_r4/Kconfig.arduino_nano_r4
```kconfig
# SPDX-License-Identifier: Apache-2.0

config BOARD_ARDUINO_NANO_R4
	select SOC_R7FA4M1AB3CFM
```

## boards/espressif/esp32_devkit_procpu_only/board.yml
```yaml
board:
  name: esp32_devkit_procpu_only
  full_name: ESP32-DevKitC (non-AMP partition table)
  vendor: espressif
  socs:
  - name: esp32
```

## boards/espressif/esp32_devkit_smp/Kconfig
```kconfig
# Copyright (c) 2024-2025 Espressif Systems (Shanghai) Co., Ltd.
# SPDX-License-Identifier: Apache-2.0

config HEAP_MEM_POOL_ADD_SIZE_BOARD
	int
	default 4096 if BOARD_ESP32_DEVKIT_SMP_ESP32_PROCPU
```

## boards/espressif/esp32_devkit_smp/Kconfig.esp32_devkit_smp
```kconfig
# Copyright (c) 2023-2025 Espressif Systems (Shanghai) Co., Ltd.
# SPDX-License-Identifier: Apache-2.0

config BOARD_ESP32_DEVKIT_SMP
	select SOC_ESP32_WROVER_E_N4R8
	select SOC_ESP32_PROCPU if BOARD_ESP32_DEVKIT_SMP_ESP32_PROCPU
```

## boards/espressif/esp32_devkit_smp/board.yml
```yaml
board:
  name: esp32_devkit_smp
  full_name: ESP32-DevKitC (non-AMP partition table)
  vendor: espressif
  socs:
  - name: esp32
```

## boards/espressif/esp32c6_devkitc_n4/board.yml
```yaml
board:
  name: esp32c6_devkitc_n4
  full_name: ESP32-C6-DevKitC (4MB flash)
  vendor: espressif
  socs:
  - name: esp32c6
```

## boards/weact/bluepillplus_f103cb/board.yml
```yaml
board:
  name: weact_bluepillplus_f103cb
  full_name: WeAct BluePill Plus (STM32F103CBT6)
  vendor: weact
  socs:
    - name: stm32f103xb
```
